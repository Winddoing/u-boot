## arch/arm/mach-dfd/Kconfig
```kconfig
if ARCH_DFD

config SYS_BOARD
	default "dfd"

config SYS_CONFIG_NAME
	default "dfd"

config SYS_SOC
	default "dfd-soc"

config DFD_CONFIG
	bool "DFD config"
	default y
	select ARM64
	select GICV2
	select BINMAN
	select OF_CONTROL
	select DM_SERIAL
	select PL01X_SERIAL
	imply CMD_DM
	imply DFD_SPL_CFG

config DFD_SPL_CFG
	bool
	select SUPPORT_SPL
	select SPL
	select SPL_OF_CONTROL if SPL
	select SPL_DM if SPL
	select HAS_CUSTOM_SYS_INIT_SP_ADDR
	imply SPL_LIBCOMMON_SUPPORT if SPL
	imply SPL_LIBGENERIC_SUPPORT if SPL
	imply SPL_SYS_MALLOC_F if SPL
	imply SPL_SYS_MALLOC_SIMPLE if SPL


#if DFD_RAM_ADDR && SPL_SHARES_INIT_SP_ADDR
if DFD_SPL_CFG

config SPL_TEXT_BASE
	default 0xFFF01000

config SPL_MAX_SIZE
	default 0x1F000 if SPL_TEXT_BASE = 0xFFF01000

config SPL_SIZE_LIMIT
	default 0x1F000 if SPL_TEXT_BASE = 0xFFF01000

config SPL_BSS_START_ADDR
	default 0xFFF1C000 if SPL_TEXT_BASE = 0xFFF01000

config SPL_BSS_MAX_SIZE
	default 0x4000 if SPL_BSS_START_ADDR = 0xFFF1C000

config SPL_HAS_BSS_LINKER_SECTION
	default y if ARM64

config CUSTOM_SYS_INIT_SP_ADDR
	default 0xFFF19000 if SPL_TEXT_BASE = 0xFFF01000


config SYS_MALLOC_F_LEN
	default 0x3000 if CUSTOM_SYS_INIT_SP_ADDR = 0xFFF19000

config SPL_SYS_MALLOC_F_LEN
	default 0x3000 if CUSTOM_SYS_INIT_SP_ADDR = 0xFFF19000

config SPL_STACK_R
	default y if CUSTOM_SYS_INIT_SP_ADDR = 0xFFF19000

config SPL_STACK_R_ADDR
	default 0x1000000 if CUSTOM_SYS_INIT_SP_ADDR = 0xFFF19000

config SPL_STACK_R_MALLOC_SIMPLE_LEN
	default 0x200000 if SPL_STACK_R_ADDR = 0x1000000

config TEXT_BASE
	default 0x200000 if SPL_TEXT_BASE = 0xFFF01000

config SYS_LOAD_ADDR
	default 0x880000 if SPL_TEXT_BASE = 0xFFF01000
endif

endif
```

## board/samsung/wdg/Kconfig
```kconfig
if TARGET_S5P_WDG

config SYS_BOARD
	default "wdg"

config SYS_VENDOR
	default "samsung"

config SYS_SOC
	default "s5pc1xx"

config SYS_CONFIG_NAME
	default "s5p_wdg"

endif
```

## configs/dfd_defconfig
```kconfig
CONFIG_ARM=y
CONFIG_COUNTER_FREQUENCY=24000000
# CONFIG_ARM64_SUPPORT_AARCH32 is not set
CONFIG_ARCH_DFD=y
CONFIG_ENV_SIZE=0x40000
CONFIG_ENV_SECT_SIZE=0x40000
CONFIG_DEFAULT_DEVICE_TREE="dfd"
CONFIG_SPL_MMC=y
CONFIG_SPL_SERIAL=y
CONFIG_PRE_CON_BUF_ADDR=0x40100000
CONFIG_DEBUG_UART_BASE=0xf1800000
CONFIG_DEBUG_UART_CLOCK=0
CONFIG_DEBUG_UART_BOARD_INIT=y
CONFIG_ARMV8_SWITCH_TO_EL1=y
CONFIG_ENV_ADDR=0x4000000
CONFIG_PCI=y
CONFIG_DEBUG_UART=y
CONFIG_ENV_VARS_UBOOT_CONFIG=y
# CONFIG_EFI_LOADER is not set
CONFIG_TIMESTAMP=y
CONFIG_FIT=y
CONFIG_SPL_LOAD_FIT=y
# CONFIG_BOOTSTD is not set
CONFIG_SUPPORT_RAW_INITRD=y
CONFIG_USE_BOOTCOMMAND=y
CONFIG_BOOTCOMMAND="run dfd_boot"
CONFIG_CONSOLE_RECORD=y
CONFIG_PRE_CONSOLE_BUFFER=y
CONFIG_CONSOLE_MUX=y
CONFIG_SYS_STDIO_DEREGISTER=y
CONFIG_CYCLIC=y
CONFIG_BOARD_LATE_INIT=y
CONFIG_PCI_INIT_R=y
CONFIG_SYS_EARLY_PCI_INIT=y
CONFIG_SPL_LEGACY_IMAGE_FORMAT=y
CONFIG_SPL_SYS_MMCSD_RAW_MODE=y
CONFIG_SYS_MMCSD_RAW_MODE_U_BOOT_SECTOR=0x400
# CONFIG_SYS_MMCSD_FS_BOOT is not set
CONFIG_HUSH_PARSER=y
CONFIG_CMD_SMBIOS=y
# CONFIG_BOOTM_PLAN9 is not set
# CONFIG_BOOTM_RTEMS is not set
# CONFIG_BOOTM_VXWORKS is not set
# CONFIG_CMD_ELF is not set
# CONFIG_CMD_IMI is not set
# CONFIG_CMD_XIMG is not set
# CONFIG_CMD_EDITENV is not set
# CONFIG_CMD_ENV_EXISTS is not set
# CONFIG_CMD_LZMADEC is not set
# CONFIG_CMD_UNLZ4 is not set
# CONFIG_CMD_UNZIP is not set
CONFIG_CMD_DFU=y
CONFIG_CMD_MMC=y
CONFIG_CMD_PCI=y
CONFIG_CMD_POWEROFF=y
# CONFIG_CMD_ITEST is not set
# CONFIG_CMD_SOURCE is not set
# CONFIG_CMD_SETEXPR is not set
# CONFIG_BOOTP_BOOTPATH is not set
# CONFIG_BOOTP_DNS is not set
# CONFIG_BOOTP_GATEWAY is not set
# CONFIG_BOOTP_HOSTNAME is not set
# CONFIG_BOOTP_SUBNETMASK is not set
CONFIG_CMD_DHCP=y
CONFIG_CMD_MII=y
CONFIG_CMD_PING=y
CONFIG_CMD_UUID=y
CONFIG_CMD_EXT2=y
CONFIG_CMD_EXT4=y
CONFIG_CMD_FAT=y
CONFIG_CMD_FS_GENERIC=y
# CONFIG_DOS_PARTITION is not set
CONFIG_OF_BOARD=y
CONFIG_ENV_IS_IN_FLASH=y
CONFIG_DNS=y
CONFIG_WGET=y
# CONFIG_BLOCK_CACHE is not set
CONFIG_DFU_TFTP=y
CONFIG_DFU_RAM=y
CONFIG_SET_DFU_ALT_INFO=y
# CONFIG_GPIO is not set
# CONFIG_I2C is not set
# CONFIG_INPUT is not set
CONFIG_DM_KEYBOARD=y
CONFIG_MMC_SDHCI=y
CONFIG_MMC_SDHCI_DFD=y
CONFIG_E1000=y
CONFIG_NVME_PCI=y
CONFIG_PCIE_ECAM_GENERIC=y
# CONFIG_POWER is not set
CONFIG_DM_RNG=y
CONFIG_DEBUG_UART_PL011=y
CONFIG_DEBUG_UART_SHIFT=2
CONFIG_DEBUG_UART_ANNOUNCE=y
CONFIG_FAT_WRITE=y
CONFIG_FAT_RENAME=y
CONFIG_MBEDTLS_LIB=y
# CONFIG_SHA256 is not set
CONFIG_SHA384=y
CONFIG_SPL_CRC32=y
CONFIG_LZ4=y
CONFIG_LZMA=y
CONFIG_GENERATE_SMBIOS_TABLE_VERBOSE=y
# CONFIG_TOOLS_KWBIMAGE is not set
```

## configs/s5p_wdg_defconfig
```kconfig
CONFIG_ARM=y
CONFIG_SYS_DCACHE_OFF=y
CONFIG_ARCH_CPU_INIT=y
CONFIG_ARCH_S5PC1XX=y
CONFIG_SYS_TEXT_BASE=0x23E00000
CONFIG_SPL_LIBGENERIC_SUPPORT=y
CONFIG_NR_DRAM_BANKS=3
CONFIG_ENV_SIZE=0x4000
CONFIG_ENV_OFFSET=0x2200
CONFIG_DEFAULT_DEVICE_TREE="s5pc1xx-wdg"
CONFIG_TARGET_S5P_WDG=y
CONFIG_SPL_SIZE_LIMIT=0x4000
CONFIG_SPL=y
CONFIG_ENV_VARS_UBOOT_CONFIG=y
CONFIG_FIT=y
CONFIG_USE_BOOTCOMMAND=y
CONFIG_BOOTCOMMAND="run tftpboot"
CONFIG_SYS_CONSOLE_IS_IN_ENV=y
CONFIG_MISC_INIT_R=y
CONFIG_HUSH_PARSER=y
# CONFIG_AUTO_COMPLETE is not set
CONFIG_SYS_PROMPT="wdg # "
CONFIG_CMD_BOOTZ=y
# CONFIG_CMD_XIMG is not set
CONFIG_CMD_THOR_DOWNLOAD=y
CONFIG_CMD_MEMINFO=y
CONFIG_CMD_DFU=y
# CONFIG_CMD_FLASH is not set
CONFIG_CMD_GPT=y
CONFIG_CMD_MMC=y
CONFIG_CMD_USB_MASS_STORAGE=y
# CONFIG_CMD_SETEXPR is not set
CONFIG_CMD_PING=y
CONFIG_CMD_CACHE=y
# CONFIG_CMD_SLEEP is not set
CONFIG_CMD_EXT4=y
CONFIG_CMD_EXT4_WRITE=y
CONFIG_CMD_FAT=y
# CONFIG_SPL_DOS_PARTITION is not set
CONFIG_ENV_OVERWRITE=y
CONFIG_ENV_IS_IN_MMC=y
CONFIG_SYS_RELOC_GD_ENV_ADDR=y
CONFIG_ENV_VARS_UBOOT_RUNTIME_CONFIG=y
CONFIG_DFU_MMC=y
CONFIG_SYS_DFU_DATA_BUF_SIZE=0x2000000
CONFIG_DM_I2C_GPIO=y
CONFIG_MMC_SDHCI=y
CONFIG_MMC_SDHCI_ADMA=y
CONFIG_MMC_SDHCI_S5P=y
CONFIG_MTD=y
CONFIG_DM_ETH=y
CONFIG_SMC911X=y
CONFIG_DM_PMIC=y
CONFIG_DM_PMIC_MAX8998=y
# CONFIG_SPECIFY_CONSOLE_INDEX is not set
CONFIG_USB=y
CONFIG_USB_GADGET=y
CONFIG_USB_GADGET_MANUFACTURER="Samsung"
CONFIG_USB_GADGET_VENDOR_NUM=0x04e8
CONFIG_USB_GADGET_PRODUCT_NUM=0x6601
CONFIG_USB_GADGET_DWC2_OTG=y
CONFIG_USB_GADGET_DOWNLOAD=y
CONFIG_USB_FUNCTION_THOR=y
# CONFIG_SPL_USE_TINY_PRINTF is not set
# CONFIG_SHA256 is not set
```
